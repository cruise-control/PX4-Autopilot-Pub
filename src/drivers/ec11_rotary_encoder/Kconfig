## src/drivers/ec11_rotary_encoder/Kconfig
```kconfig
menuconfig DRIVERS_EC11_ROTARY_ENCODER
	bool "ec11_rotary_encoder"
	default n
	---help---
		Enable support for ec11_rotary_encoder
```

## src/drivers/st7789_display/Kconfig
```kconfig
menuconfig DRIVERS_ST7789_DISPLAY
	bool "st7789_display"
	default n
	---help---
		Enable support for st7789_display
```

## src/modules/servo_test/Kconfig
```kconfig
menuconfig MODULES_SERVO_TEST
	bool "servo_test"
	default n
	---help---
		Bench motor test driven by the EC11 rotary encoder and the ST7789
		display: the dial sets a target RPM, the shaft button enables/disables
		the output, and ESC telemetry is shown on screen. Drives motors via
		the actuator_test topic (works while disarmed).
```
